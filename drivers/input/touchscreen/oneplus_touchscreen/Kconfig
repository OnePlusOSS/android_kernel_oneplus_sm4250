## drivers/input/touchscreen/oneplus_touchscreen/Kconfig
```kconfig
config TOUCHPANEL_MTK_PLATFORM
	bool "ONEPLUS platform tp module used"
	help
	  Say Y here if you have mtk-platform.

config TOUCHPANEL_LATE_INIT
	bool "mk6360 pmic init"
	help
	  Say Y here if you have mk6360 pmic.

config TOUCHIRQ_UPDATE_QOS
	bool "ONEPLUS touchpanel driver update qos"
	help
	  Say Y here if you want to update qos value in irq handler.

config TOUCHPANEL_NEW_SET_IRQ_WAKE
	bool "ONEPLUS platform tp module used"
	help
	  Say Y here if call enable_irq_wake, can not call disable_irq_nosync

config TOUCHPANEL_ONEPLUS
	bool "onplus tp module"
	help
	  Say Y here if you have touchscreen module.

config ONEPLUS_TP_APK
	bool "oneplus apk node create"
	help
	  Say Y here if you use apk for TP.

config TOUCHPANEL_MULTI_NOFLASH
	bool "Multiple noflash TPs using"
	help
	  Say Y here if you have multiple noflash touchscreen.

config TOUCHPANEL_NOVA
#	default y
	bool "TP Nova_IC enable or not for ONEPLUS"
	---help---
	say Y to enable driver for Touchpanel using NOVATECK_IC

config TOUCHPANEL_ILITEK
#	default y
	bool "TP ilitek IC enable or not for ONEPLUS"
	---help---
	say Y to enable driver for Touchpanel using ilitek IC
	
source "drivers/input/touchscreen/oneplus_touchscreen/util_interface/Kconfig"

if TOUCHPANEL_NOVA
source "drivers/input/touchscreen/oneplus_touchscreen/Novatek/Kconfig"
endif

if TOUCHPANEL_ILITEK
source "drivers/input/touchscreen/oneplus_touchscreen/ilitek/Kconfig"
endif
```

## drivers/input/touchscreen/oneplus_touchscreen/Novatek/Kconfig
```kconfig
source "drivers/input/touchscreen/oneplus_touchscreen/Novatek/NT36525B_noflash/Kconfig"
```

## drivers/input/touchscreen/oneplus_touchscreen/Novatek/NT36525B_noflash/Kconfig
```kconfig
config TOUCHPANEL_NOVA_NT36525B_NOFLASH
#	default y
	bool "TP nova nt36525B IC enable or not for ONEPLUS"
	---help---
	say Y to enable driver for Touchpanel useing nova nt36525B
```

## drivers/input/touchscreen/oneplus_touchscreen/ilitek/Kconfig
```kconfig
source "drivers/input/touchscreen/oneplus_touchscreen/ilitek/ilitek9881h_v3/Kconfig"

source "drivers/input/touchscreen/oneplus_touchscreen/ilitek/ilitek9882n/Kconfig"
```

## drivers/input/touchscreen/oneplus_touchscreen/ilitek/ilitek9881h_v3/Kconfig
```kconfig
config TOUCHPANEL_ILITEK_ILITEK9881H_V3
#	default y
	bool "TP ilitek ilitek9881h IC enable or not for ONEPLUS"
	---help---
	say Y to enable driver for Touchpanel using ilitek ilitek9881h
```

## drivers/input/touchscreen/oneplus_touchscreen/ilitek/ilitek9882n/Kconfig
```kconfig
config TOUCHPANEL_ILITEK_ILITEK9882N_V3
#	default y
	bool "TP ilitek ilitek9882n IC enable or not for ONEPLUS"
	---help---
	say Y to enable driver for Touchpanel using ilitek ilitek9881h
```

## drivers/power/Kconfig
```kconfig
config ONEPLUS_PMI632_CHARGER
	tristate "CONFIG_ONEPLUS_PMI632_CHARGER driver"
	help
	  Enables support for the oneplus charging framework
config ONEPLUS_PMI632_CHARGER
	tristate "CONFIG_ONEPLUS_PMI632_CHARGER driver"
	help
	  Enables support for the oneplus charging framework

config ONEPLUS_SHORT_C_BATT_CHECK
	bool "ONEPLUS batt short "
	help
	  Say Y here to declare ONEPLUS batt short

config ONEPLUS_RTC_DET_SUPPORT
	tristate "ONEPLUS RTC DET SUPPORT"
	default n
	help
	  Say Y to include support

config ONEPLUS_CHECK_CHARGERID_VOLT
	tristate "ONEPLUS CHECK CHARGERID VOLT"
	default n
	help
	  Say Y to include support

config ONEPLUS_SHIP_MODE_SUPPORT
	tristate "ONEPLUS_SHIP_MODE_SUPPORT"
	default n
	help
	  Say Y to include support

config ONEPLUS_CALL_MODE_SUPPORT
	tristate "ONEPLUS_CALL_MODE_SUPPORT"
	default n
	help
	  Say Y to include support

config ONEPLUS_SHORT_IC_CHECK
	bool "ONEPLUS short ic"
	help
	  Say Y here to declare ONEPLUS batt short

config ONEPLUS_SHORT_HW_CHECK
	bool "ONEPLUS batt HW SHORT "
	help
	  Say Y here to declare charging system is on MTK

config ONEPLUS_CHIP_SOC_NODE
	bool "ONEPLUS chip soc node"
	help
	  Say Y to include support

config ONEPLUS_SMART_CHARGER_SUPPORT
	bool "ONEPLUS smart charge support"
	help
	  Say Y to include support

source "drivers/power/oneplus/Kconfig"
source "drivers/power/avs/Kconfig"
source "drivers/power/reset/Kconfig"
source "drivers/power/supply/Kconfig"
```

## drivers/power/oneplus/Kconfig
```kconfig
menuconfig ONEPLUS_CHARGER
	bool "ONEPLUS charging system"
	depends on I2C
	select REGMAP_I2C
	help
	  Say Y here to enable ONEPLUS charging system support

if ONEPLUS_CHARGER
config ONEPLUS_CHARGER_MTK
	bool "ONEPLUS charger on MTK"
	help
	  Say Y here to declare charging system is on MTK

config ONEPLUS_SHORT_C_BATT_CHECK
	bool "ONEPLUS batt short "
	help
	  Say Y here to declare ONEPLUS batt short

config ONEPLUS_STANDARD_BATTERY_CHECK_ADC
	bool "ONEPLUS Official Standard Battery check by ADC"
	help
	  Say Y here to support Official Standard Battery check by ADC

config ONEPLUS_SHORT_IC_CHECK
	bool "ONEPLUS short ic"
	help
	  Say Y here to declare ONEPLUS batt short

config ONEPLUS_SHORT_HW_CHECK
	bool "ONEPLUS batt HW SHORT "
	help
	  Say Y here to declare charging system is on MTK

config ONEPLUS_SHORT_USERSPACE
	bool "ONEPLUS batt userspace"
	help
	  Say Y to include support

config ONEPLUS_CHIP_SOC_NODE
	bool "ONEPLUS chip soc node"
	help
	  Say Y to include support
endif #ONEPLUS_CHARGER
```

## drivers/soc/oneplus/Kconfig
```kconfig
config ONEPLUS_DEVICE_IFNO
  bool "config oneplus devinfo software"
  default y
  help
    define this config to compile devinfo.c for device register
```
