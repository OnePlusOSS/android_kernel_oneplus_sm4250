&mdss_mdp {
	dsi_ili9881h_90hz_boe_video: qcom,mdss_dsi_ili9881h_90hz_boe_video {
		qcom,mdss-dsi-panel-name =
				"ili9881h 90hz boe fhd video mode dsi panel";
		qcom,mdss-dsi-panel-type = "dsi_video_mode";
		qcom,dsi-ctrl-num = <0>;
		qcom,dsi-phy-num = <0>;
		qcom,mdss-dsi-virtual-channel-id = <0>;
		qcom,mdss-dsi-stream = <0>;
		qcom,mdss-dsi-h-left-border = <0>;
		qcom,mdss-dsi-h-right-border = <0>;
		qcom,mdss-dsi-v-top-border = <0>;
		qcom,mdss-dsi-v-bottom-border = <0>;
		qcom,mdss-dsi-bpp = <24>;
		qcom,mdss-dsi-color-order = "rgb_swap_rgb";
		qcom,mdss-dsi-underflow-color = <0xff>;
		qcom,mdss-dsi-border-color = <0>;
		qcom,mdss-dsi-h-sync-pulse = <0>;
		qcom,mdss-dsi-traffic-mode = "non_burst_sync_event";
		qcom,mdss-dsi-lane-map = "lane_map_0123";
		qcom,mdss-dsi-bllp-eof-power-mode;
		qcom,mdss-dsi-bllp-power-mode;
		qcom,ulps-enabled;
		qcom,suspend-ulps-enabled;
		qcom,mdss-dsi-tx-eot-append;
		qcom,mdss-dsi-lane-0-state;
		qcom,mdss-dsi-lane-1-state;
		qcom,mdss-dsi-lane-2-state;
		qcom,mdss-dsi-lane-3-state;
		qcom,mdss-dsi-dma-trigger = "trigger_sw";
		qcom,mdss-dsi-mdp-trigger = "none";
		qcom,mdss-dsi-lp11-init;
		qcom,mdss-dsi-reset-sequence = <1 10>, <0 10>, <1 10>;
		qcom,mdss-pan-physical-width-dimension = <68>;
		qcom,mdss-pan-physical-height-dimension = <151>;
		oneplus,mdss-dsi-vendor-name = "ILI9881H-90HZ";
		oneplus,mdss-dsi-manufacture = "BOE";
		oneplus,dsi-brightness-remapping = <1 1>, <2 2>, <1023 891>, <2047 1782>;
		qcom,mdss-dsi-display-timings {
			timing@0 {
				qcom,mdss-dsi-video-mode;
				qcom,mdss-dsi-panel-width = <720>;
				qcom,mdss-dsi-panel-height = <1600>;
				qcom,mdss-dsi-h-front-porch = <40>;
				qcom,mdss-dsi-h-back-porch = <12>;
				qcom,mdss-dsi-h-pulse-width = <8>;
				qcom,mdss-dsi-h-sync-skew = <0>;
				qcom,mdss-dsi-v-back-porch = <20>;
				qcom,mdss-dsi-v-front-porch = <1324>;
				qcom,mdss-dsi-v-pulse-width = <8>;
				qcom,mdss-dsi-panel-framerate = <60>;
				qcom,mdss-dsi-on-command = [
                                        39 01 00 00 00 00 04 FF 98 81 03
                                        15 01 00 00 00 00 02 83 30
                                        15 01 00 00 00 00 02 84 00
                                        15 01 00 00 00 00 02 91 F4
                                        15 01 00 00 00 00 02 92 15
                                        15 01 00 00 00 00 02 94 0F
                                        15 01 00 00 00 00 02 95 0F
                                        15 01 00 00 00 00 02 96 10
                                        15 01 00 00 00 00 02 97 10
                                        15 01 00 00 00 00 02 98 11
                                        15 01 00 00 00 00 02 99 12
                                        15 01 00 00 00 00 02 9A 13
                                        15 01 00 00 00 00 02 9B 14
                                        15 01 00 00 00 00 02 9C 15
                                        15 01 00 00 00 00 02 9D 16
                                        15 01 00 00 00 00 02 89 40
                                        15 01 00 00 00 00 02 86 3F
                                        39 01 00 00 00 00 04 FF 98 81 00
                                        15 01 00 00 00 00 02 53 24
                                        15 01 00 00 00 00 02 55 01
                                        39 01 00 00 00 00 04 FF 98 81 00
                                        15 01 00 00 00 00 02 35 00
                                        05 01 00 00 50 00 02 11 00 /* delay 80ms */
                                        39 01 00 00 00 00 04 FF 98 81 05
                                        15 01 00 00 00 00 02 50 2F
                                        15 01 00 00 00 00 02 68 8D
                                        15 01 00 00 00 00 02 69 93
                                        39 01 00 00 00 00 04 FF 98 81 06
                                        15 01 00 00 00 00 02 58 CB
                                        15 01 00 00 00 00 02 C7 05
                                        39 01 00 00 00 00 04 FF 98 81 00
                                        05 01 00 00 0A 00 02 29 00 /* delay 10ms */
				];
				qcom,mdss-dsi-off-command = [
					39 01 00 00 00 00 04 FF 98 81 00
					05 01 00 00 14 00 02 28 00
					05 01 00 00 78 00 02 10 00
				];
				qcom,mdss-dsi-cabc-low-mode-command = [
					39 01 00 00 00 00 04 FF 98 81 00
					15 01 00 00 00 00 02 55 01
				];
				qcom,mdss-dsi-cabc-high-mode-command = [
					39 01 00 00 00 00 04 FF 98 81 00
					15 01 00 00 00 00 02 55 02
				];
				qcom,mdss-dsi-cabc-off-command = [
					39 01 00 00 00 00 04 FF 98 81 00
					15 01 00 00 00 00 02 55 00
				];
				qcom,mdss-dsi-on-command-state = "dsi_lp_mode";
				qcom,mdss-dsi-off-command-state = "dsi_lp_mode";
				qcom,mdss-dsi-cabc-low-mode-command-state = "dsi_hs_mode";
				qcom,mdss-dsi-cabc-high-mode-command-state = "dsi_hs_mode";
				qcom,mdss-dsi-cabc-off-command-state = "dsi_hs_mode";
			};
		};
	};
};
