&mdss_mdp {
	dsi_ili9882n_90hz_video: qcom,mdss_dsi_ili9882n_90hz_video {
		qcom,mdss-dsi-panel-name =
				"ili9882n 90hz fhd video mode dsi panel";
		qcom,mdss-dsi-panel-type = "dsi_video_mode";
		qcom,dsi-ctrl-num = <0>;
		qcom,dsi-phy-num = <0>;
		qcom,mdss-dsi-virtual-channel-id = <0>;
		qcom,mdss-dsi-stream = <0>;
		qcom,mdss-dsi-h-left-border = <0>;
		qcom,mdss-dsi-h-right-border = <0>;
		qcom,mdss-dsi-v-top-border = <0>;
		qcom,mdss-dsi-v-bottom-border = <0>;
		qcom,mdss-dsi-bpp = <24>;
		qcom,mdss-dsi-color-order = "rgb_swap_rgb";
		qcom,mdss-dsi-underflow-color = <0xff>;
		qcom,mdss-dsi-border-color = <0>;
		qcom,mdss-dsi-h-sync-pulse = <0>;
		qcom,mdss-dsi-traffic-mode = "non_burst_sync_event";
		qcom,mdss-dsi-lane-map = "lane_map_0123";
		qcom,mdss-dsi-bllp-eof-power-mode;
		qcom,mdss-dsi-bllp-power-mode;
		qcom,ulps-enabled;
		qcom,suspend-ulps-enabled;
		qcom,mdss-dsi-tx-eot-append;
		qcom,mdss-dsi-lane-0-state;
		qcom,mdss-dsi-lane-1-state;
		qcom,mdss-dsi-lane-2-state;
		qcom,mdss-dsi-lane-3-state;
		qcom,mdss-dsi-dma-trigger = "trigger_sw";
		qcom,mdss-dsi-mdp-trigger = "none";
		qcom,mdss-dsi-lp11-init;
		qcom,mdss-dsi-reset-sequence = <1 10>, <0 10>, <1 10>;
		qcom,mdss-pan-physical-width-dimension = <68>;
		qcom,mdss-pan-physical-height-dimension = <151>;
		oneplus,mdss-dsi-vendor-name = "ILI9882N-90HZ";
		oneplus,mdss-dsi-manufacture = "BOE";
		oneplus,dsi-brightness-remapping = <1 1>, <2 2>, <1023 891>, <2047 1782>;
		qcom,mdss-dsi-display-timings {
			timing@0 {
				qcom,mdss-dsi-video-mode;
				qcom,mdss-dsi-panel-width = <720>;
				qcom,mdss-dsi-panel-height = <1600>;
				qcom,mdss-dsi-h-front-porch = <28>;
				qcom,mdss-dsi-h-back-porch = <28>;
				qcom,mdss-dsi-h-pulse-width = <8>;
				qcom,mdss-dsi-h-sync-skew = <0>;
				qcom,mdss-dsi-v-back-porch = <18>;
				qcom,mdss-dsi-v-front-porch = <1348>;
				qcom,mdss-dsi-v-pulse-width = <2>;
				qcom,mdss-dsi-panel-framerate = <60>;
				qcom,mdss-dsi-on-command = [
                                        39 01 00 00 00 00 04 FF 98 82 03
                                        15 01 00 00 00 00 02 83 30
                                        15 01 00 00 00 00 02 84 00
                                        15 01 00 00 00 00 02 88 E2
                                        15 01 00 00 00 00 02 89 EA
                                        15 01 00 00 00 00 02 8A F6
                                        15 01 00 00 00 00 02 8B F6
                                        15 01 00 00 00 00 02 8C BF
                                        15 01 00 00 00 00 02 8D C5
                                        15 01 00 00 00 00 02 8E CB
                                        15 01 00 00 00 00 02 8F D1
                                        15 01 00 00 00 00 02 90 D7
                                        15 01 00 00 00 00 02 91 DD
                                        15 01 00 00 00 00 02 92 E3
                                        15 01 00 00 00 00 02 93 E9
                                        15 01 00 00 00 00 02 94 F6
                                        15 01 00 00 00 00 02 95 F6
                                        39 01 00 00 00 00 04 FF 98 82 06
                                        15 01 00 00 00 00 02 48 05
                                        15 01 00 00 00 00 02 4D 80
                                        15 01 00 00 00 00 02 4E 40
                                        15 01 00 00 00 00 02 C7 05
                                        39 01 00 00 00 00 04 FF 98 82 00
                                        15 01 00 00 00 00 02 35 00
                                        15 01 00 00 00 00 02 53 24
                                        15 01 00 00 00 00 02 55 01
                                        05 01 00 00 78 00 02 11 00
                                        39 01 00 00 00 00 04 FF 98 82 01
                                        15 01 00 00 00 00 02 05 33
                                        15 01 00 00 00 00 02 07 00
                                        39 01 00 00 00 00 04 FF 98 82 02
                                        15 01 00 00 00 00 02 06 57
                                        15 01 00 00 00 00 02 0D 1C
                                        15 01 00 00 00 00 02 0E 7B
                                        39 01 00 00 00 00 04 FF 98 82 0B
                                        15 01 00 00 00 00 02 9B CE
                                        15 01 00 00 00 00 02 9E 46
                                        15 01 00 00 00 00 02 9F 46
                                        39 01 00 00 00 00 04 FF 98 82 00
                                        05 01 00 00 14 00 02 29 00
				];
				qcom,mdss-dsi-off-command = [
					39 01 00 00 00 00 04 FF 98 82 00
					05 01 00 00 14 00 02 28 00
					05 01 00 00 78 00 02 10 00
				];
				qcom,mdss-dsi-cabc-low-mode-command = [
					39 01 00 00 00 00 04 FF 98 82 00
					15 01 00 00 00 00 02 55 01
				];
				qcom,mdss-dsi-cabc-high-mode-command = [
					39 01 00 00 00 00 04 FF 98 82 00
					15 01 00 00 00 00 02 55 02
				];
				qcom,mdss-dsi-cabc-off-command = [
					39 01 00 00 00 00 04 FF 98 82 00
					15 01 00 00 00 00 02 55 00
				];
				qcom,mdss-dsi-on-command-state = "dsi_lp_mode";
				qcom,mdss-dsi-off-command-state = "dsi_lp_mode";
				qcom,mdss-dsi-cabc-low-mode-command-state = "dsi_hs_mode";
				qcom,mdss-dsi-cabc-high-mode-command-state = "dsi_hs_mode";
				qcom,mdss-dsi-cabc-off-command-state = "dsi_hs_mode";
			};
		};
	};
};
