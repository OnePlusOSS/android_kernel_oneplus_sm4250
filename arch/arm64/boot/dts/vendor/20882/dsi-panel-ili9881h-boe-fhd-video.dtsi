&mdss_mdp {
	dsi_ili9881h_boe_video: qcom,mdss_dsi_ili9881h_boe_video {
		qcom,mdss-dsi-panel-name =
				"ili9881h boe fhd video mode dsi panel";
		qcom,mdss-dsi-panel-type = "dsi_video_mode";
		qcom,dsi-ctrl-num = <0>;
		qcom,dsi-phy-num = <0>;
		qcom,mdss-dsi-virtual-channel-id = <0>;
		qcom,mdss-dsi-stream = <0>;
		qcom,mdss-dsi-h-left-border = <0>;
		qcom,mdss-dsi-h-right-border = <0>;
		qcom,mdss-dsi-v-top-border = <0>;
		qcom,mdss-dsi-v-bottom-border = <0>;
		qcom,mdss-dsi-bpp = <24>;
		qcom,mdss-dsi-color-order = "rgb_swap_rgb";
		qcom,mdss-dsi-underflow-color = <0xff>;
		qcom,mdss-dsi-border-color = <0>;
		qcom,mdss-dsi-h-sync-pulse = <0>;
		qcom,mdss-dsi-traffic-mode = "non_burst_sync_event";
		qcom,mdss-dsi-lane-map = "lane_map_0123";
		qcom,mdss-dsi-bllp-eof-power-mode;
		qcom,mdss-dsi-bllp-power-mode;
		qcom,ulps-enabled;
		qcom,suspend-ulps-enabled;
		qcom,mdss-dsi-tx-eot-append;
		qcom,mdss-dsi-lane-0-state;
		qcom,mdss-dsi-lane-1-state;
		qcom,mdss-dsi-lane-2-state;
		qcom,mdss-dsi-dma-trigger = "trigger_sw";
		qcom,mdss-dsi-mdp-trigger = "none";
		qcom,mdss-dsi-lp11-init;
		qcom,mdss-dsi-reset-sequence = <1 10>, <0 10>, <1 10>;
		qcom,mdss-pan-physical-width-dimension = <68>;
		qcom,mdss-pan-physical-height-dimension = <151>;
		oneplus,mdss-dsi-vendor-name = "ILI9881H";
		oneplus,mdss-dsi-manufacture = "BOE";
		oneplus,dsi-brightness-remapping = <1 1>, <2 2>, <1023 891>, <2047 1782>;
		qcom,mdss-dsi-display-timings {
			timing@0 {
				qcom,mdss-dsi-video-mode;
				qcom,mdss-dsi-panel-width = <720>;
				qcom,mdss-dsi-panel-height = <1600>;
				qcom,mdss-dsi-h-front-porch = <18>;
				qcom,mdss-dsi-h-back-porch = <32>;
				qcom,mdss-dsi-h-pulse-width = <8>;
				qcom,mdss-dsi-h-sync-skew = <0>;
				qcom,mdss-dsi-v-back-porch = <16>;
				qcom,mdss-dsi-v-front-porch = <245>;
				qcom,mdss-dsi-v-pulse-width = <2>;
				qcom,mdss-dsi-panel-framerate = <60>;
				qcom,mdss-dsi-on-command = [
					39 01 00 00 00 00 04 FF 98 81 06
					15 01 00 00 00 00 02 3E 60
					39 01 00 00 00 00 04 FF 98 81 01
					15 01 00 00 00 00 02 04 CF
					15 01 00 00 00 00 02 05 34
					15 01 00 00 00 00 02 06 00
					15 01 00 00 00 00 02 07 5E
					15 01 00 00 00 00 02 33 0C
					15 01 00 00 00 00 02 49 0C
					15 01 00 00 00 00 02 ED 86
					39 01 00 00 00 00 04 FF 98 81 03
					15 01 00 00 00 00 02 83 30
					15 01 00 00 00 00 02 84 00
					15 01 00 00 00 00 02 94 0F
					15 01 00 00 00 00 02 95 0F
					15 01 00 00 00 00 02 96 10
					15 01 00 00 00 00 02 97 11
					15 01 00 00 00 00 02 98 12
					15 01 00 00 00 00 02 99 13
					15 01 00 00 00 00 02 9A 14
					15 01 00 00 00 00 02 9B 15
					15 01 00 00 00 00 02 9C 16
					15 01 00 00 00 00 02 9D 17
					39 01 00 00 00 00 04 FF 98 81 00
					15 01 00 00 00 00 02 53 24
					15 01 00 00 00 00 02 55 01
					39 01 00 00 00 00 04 FF 98 81 00
					15 01 00 00 00 00 02 35 00
					05 01 00 00 78 00 02 11 00
					05 01 00 00 29 00 02 29 00
				];
				qcom,mdss-dsi-off-command = [
					39 01 00 00 00 00 04 FF 98 81 00
					05 01 00 00 14 00 02 28 00
					05 01 00 00 78 00 02 10 00
				];
				qcom,mdss-dsi-cabc-low-mode-command = [
					39 01 00 00 00 00 04 FF 98 81 00
					39 01 00 00 00 00 02 55 01
				];
				qcom,mdss-dsi-cabc-high-mode-command = [
					39 01 00 00 00 00 04 FF 98 81 00
					39 01 00 00 00 00 02 55 02
				];
				qcom,mdss-dsi-cabc-off-command = [
					39 01 00 00 00 00 04 FF 98 81 00
					39 01 00 00 00 00 02 55 00
				];
				qcom,mdss-dsi-on-command-state = "dsi_lp_mode";
				qcom,mdss-dsi-off-command-state = "dsi_lp_mode";
				qcom,mdss-dsi-cabc-low-mode-command-state = "dsi_hs_mode";
				qcom,mdss-dsi-cabc-high-mode-command-state = "dsi_hs_mode";
				qcom,mdss-dsi-cabc-off-command-state = "dsi_hs_mode";
			};
		};
	};
};
